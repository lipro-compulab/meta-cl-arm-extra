## conf/layer.conf
```bitbake
# We have a conf and classes directory, add to BBPATH
BBPATH .= ":${LAYERDIR}"

# We have a packages directory, add to BBFILES
BBFILES += "${LAYERDIR}/recipes-*/*/*.bb \
            ${LAYERDIR}/recipes-*/*/*.bbappend"

BBFILE_COLLECTIONS += "cl-arm-extra"
BBFILE_PATTERN_cl-arm-extra := "^${LAYERDIR}/"
BBFILE_PRIORITY_cl-arm-extra = "4"

LAYERDEPENDS_cl-arm-extra = "core fsl-arm fsl-bsp-release meta-ti"
```

## conf/machine/cl-som-imx6ul.conf
```bitbake
#@TYPE: Machine
#@NAME: CompuLab CM-FX6
#@SOC: i.MX6 UL
#@DESCRIPTION: Machine configuration for CompuLab CL-SOM-iMX6UL machines
#@MAINTAINER: Valentin Raevsky <valentin@compulab.co.il>

include conf/machine/include/imx-base.inc
include conf/machine/include/tune-cortexa7.inc
include conf/machine/include/imx6ul-common.inc

SOC_FAMILY = "mx6ul"

PREFERRED_PROVIDER_u-boot_mx6ul ?= "u-boot-compulab"
PREFERRED_PROVIDER_virtual/kernel_mx6ul ?= "linux-compulab"
PREFERRED_VERSION_linux-compulab_mx6ul ?= "4.1.15"

UBOOT_MACHINE ?= "cl_som_imx6ul_defconfig"

KERNEL_DEVICETREE = "imx6ul-cl-som-imx6ul.dtb imx6ul-cl-som-imx6ul-wilink.dtb"
KERNEL_DEVICETREE += "imx6ul-sbc-imx6ul.dtb imx6ul-sbc-imx6ul-wilink.dtb"

MACHINE_FEATURES += "alsa bluetooth serial usbhost wifi"

MACHINE_FIRMWARE += "linux-firmware-wl18xx"

SERIAL_CONSOLE = "115200 ttymxc2"

#
# TODO: adjust kernel default configureation
#

# Disable LTTng modules
LTTNGUST_cl-som-imx6ul = ""
LTTNGTOOLS_cl-som-imx6ul = ""
LTTNGMODULES_cl-som-imx6ul = ""

# Disable Crypto device module and test tools
SOC_TOOLS_TESTAPPS_remove_cl-som-imx6ul = " \
    cryptodev-module \
    cryptodev-tests \
"

# Disable IMX specific test tools
SOC_TOOLS_TEST_remove_cl-som-imx6ul = " \
    imx-test \
"
```
